## main/Kconfig.projbuild
```kconfig
menu "Miniatur Town"
    config WLED_DIN_PIN
        int "WLED Data In Pin"
        default 14
        help
            The number of the WLED data in pin.

    config WLED_LED_COUNT
        int "WLED LED counter"
        default 64
        help
            The number of the WLED LEDs.
endmenu
```

## sdkconfig.defaults
```kconfig
# activate Bluetooth Low Energy (BLE)
CONFIG_BT_ENABLED=y
CONFIG_BT_NIMBLE_ENABLED=y

# NimBLE Options
CONFIG_BT_NIMBLE_SECURITY_ENABLE=n
CONFIG_BT_NIMBLE_SVC_GAP_DEVICE_NAME="miniature"

# Logging
CONFIG_LOG_DEFAULT_LEVEL_INFO=y
CONFIG_LOG_DEFAULT_LEVEL=3
CONFIG_LOG_MAXIMUM_LEVEL=3

# Flash Size
CONFIG_ESPTOOLPY_FLASHSIZE_4MB=y
CONFIG_ESPTOOLPY_FLASHSIZE="4MB"

# Partitions
CONFIG_PARTITION_TABLE_CUSTOM=y
CONFIG_PARTITION_TABLE_CUSTOM_FILENAME="partitions.csv"
```
